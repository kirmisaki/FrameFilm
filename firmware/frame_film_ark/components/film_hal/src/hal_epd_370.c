/*********************************************************************
 *
 * SPDX-License-Identifier: GPL-3.0-or-later
 *
 * Copyright (c) 2026 kiritro
 *
 * This program is free software: you can redistribute it and/or modify
 * it under the terms of the GNU General Public License as published by
 * the Free Software Foundation, either version 3 of the License, or
 * (at your option) any later version.
 *
 * This program is distributed in the hope that it will be useful,
 * but WITHOUT ANY WARRANTY; without even the implied warranty of
 * MERCHANTABILITY or FITNESS FOR A PARTICULAR PURPOSE.  See the
 * GNU General Public License for more details.
 *
 * You should have received a copy of the GNU General Public License
 * along with this program.  If not, see <https://www.gnu.org/licenses/>.
 *
 *
 * FileName : /film_hal/src/hal_epd_370.c
 * Author: kiritro  Version: v0.1  Date: 2026/8/24
 * Description: Pro 版 3.7寸 720x480 六色 EPD 驱动（JD7601, GDEH037E01），
 *              基于官方参考驱动（MSP430 版 + ESP-IDF 版）移植
 * ChangeLog: Change Notes
 *
 *********************************************************************/

/*********************************************************************
 * INCLUDES
 */
#include "hal_epd.h"
#include "freertos/FreeRTOS.h"
#include "freertos/task.h"
#include <string.h>

#include "sys_log.h"
#include <stdint.h>
#include "sdkconfig.h"
#include "esp_attr.h"

#ifdef CONFIG_ARK_EPD_PROFILE
#include "esp_timer.h"
#include <inttypes.h>
#include <stdlib.h>
#include <stdio.h>
#include "hal/gpio_ll.h"
#include "soc/gpio_struct.h"
#include "esp_intr_alloc.h"
#endif

/*********************************************************************
 * MACROS
 */
// JD7601 命令（参考 GDEH037E01 官方驱动）
#define SOFT_START                    0xE9  // 软启动（初始化）
#define POF                           0x02  // Power off
#define PON                           0x04  // Power on
#define DSLP                          0x07  // Deep sleep
#define DTM1                          0x10  // 数据传输 1（写入帧数据）
#define REF                           0x12  // Display refresh

// ---- 48 色 spectra 波形命令 ----
#define JD7601_CMD_WAVE_PRE          0x00  // 波形载入前导（后跟 0x0F 0xA9）
#define JD7601_CMD_WRITE_LUT         0x20  // 写波形表（799 字节）
#define JD7601_CMD_PLL               0x30  // PLL 控制
#define JD7601_CMD_UNK_41            0x41  // 初始化命令（语义待确认）
#define JD7601_CMD_TEMP              0xE0  // 温度控制
#define JD7601_CMD_UNK_E6            0xE6  // 初始化命令（语义待确认）

#define EPD_INPUT_LINE                (EPD_WIDTH / 2)  // 每行字节数（4bpp，720/2=360）
#define EPD_MONO_BATCH_LINES          (4)  // Matches the SPI bus transfer capacity
#define EPD_MONO_LINE                 (EPD_WIDTH / 8)  // 每行字节数（1bpp，720/8=90）
#define EPD_MONO_BYTES                (EPD_WIDTH * EPD_HEIGHT / 8)  // 43200

/* mono 2bit 跳变码（code = 2*old + new）的码位语义。
 * .film 与时钟位图约定 1=黑、0=白，而实测面板的 mono_fast/mono_clear 波形把码位
 * 1 当白、0 当黑，故编码前统一取反；若换屏/换波形后画面反色，改这里即可。
 * 注意：这里只影响“新帧”的码位，上一帧初值见 MONO_CODE_INIT_BYTE。 */
#define MONO_CODE_BIT_WHITE           (1)

/* 面板经 full_clear / mono 清屏后的实际光学状态是“黑”（实测），差分刷新的上一帧
 * 初值以此为准，不能按“清屏=白”假设，否则首帧会整屏不动或整屏压黑。 */
#define MONO_CODE_INIT_BYTE           ((MONO_CODE_BIT_WHITE) ? 0x00 : 0xFF)

// BUSY 等待超时（ms）
#define BUSY_TIMEOUT_INIT_MS          (15000)
#define BUSY_TIMEOUT_POWER_MS         (60000)
#define BUSY_TIMEOUT_REFRESH_MS       (120000)
#define BUSY_TIMEOUT_POLARITY_MS      (3000)

#define FILM_HEADER_SIZE              (32)
#define FILM_COLOR_TABLE_SIZE         (16)
#define FILM_OFFSET_FILESIZE          (0x00)
#define FILM_OFFSET_SCREENWIDTH       (0x04)
#define FILM_OFFSET_SCREENHEIGHT      (0x06)
#define FILM_OFFSET_COLORCOUNT        (0x08)
#define FILM_OFFSET_FORMAT            (0x09)   // Format 判别码：0x00=v1 4bpp, 0x01=MonoFast, 0x02=ColorQual, 0x03=ColorFast
#define FILM_OFFSET_FRAMECOUNT        (0x0A)   // 帧数（小端），0/1 表示单帧
#define FILM_OFFSET_RESERVED          (0x0C)   // 保留字段（4 字节）
#define FILM_OFFSET_COLORTABLE        (0x10)

/*********************************************************************
* TYPEDEFS
*/
// .film 文件头（32 字节，与 docs/film/film.md 字段一一对应）
typedef struct
{
    uint32_t fileSize;      // 0x00 主体大小
    uint16_t screenWidth;   // 0x04 屏幕宽度（元数据）
    uint16_t screenHeight;  // 0x06 屏幕高度（元数据）
    uint8_t  colorCount;    // 0x08 颜色数量（仅 v1 使用）
    uint8_t  format;        // 0x09 格式判别码
    uint16_t frameCount;    // 0x0A 帧数（小端），0/1=单帧，>1=多帧动画
    uint8_t  reserved[4];   // 0x0C 保留字段
    uint8_t  colorTable[FILM_COLOR_TABLE_SIZE];   // 0x10 颜色表（仅 v1 使用）
} __attribute__((packed)) FilmHeader;

/*********************************************************************
 * CONSTANTS
 */
/* JD7601 / GDEH037E01 6-color EPD 48-color spectra waveform tables. */

static const uint8_t qual_phase3[799] = {
    0x00, 0x00, 0x00, 0x00, 0x00, 0x00, 0x00, 0xef, 0xff, 0xff, 0xfd, 0xff, 0xff, 0xef, 0xff, 0xff,
    0xff, 0xff, 0xff, 0xff, 0xff, 0xff, 0xff, 0xff, 0xff, 0xff, 0xff, 0xff, 0xff, 0xff, 0xff, 0xff,
    0xff, 0xff, 0xff, 0xff, 0xff, 0xff, 0xff, 0xff, 0xff, 0xff, 0xff, 0xff, 0xff, 0xff, 0xff, 0xff,
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    0xff, 0xff, 0xff, 0xff, 0xff, 0xff, 0xff, 0xff, 0xff, 0xff, 0xff, 0xff, 0xff, 0xff, 0xff,
};

static const uint8_t qual_phase2[799] = {
    0x00, 0x00, 0x00, 0x00, 0x00, 0x00, 0x00, 0xef, 0xff, 0xff, 0x00, 0xd3, 0xff, 0xef, 0xff, 0xff,
    0xff, 0xff, 0xff, 0xff, 0xff, 0xff, 0xff, 0xff, 0xff, 0xff, 0xff, 0xff, 0xff, 0xff, 0xff, 0xff,
    0xff, 0xff, 0xff, 0xff, 0xff, 0xff, 0xff, 0xff, 0xff, 0xff, 0xff, 0xff, 0xff, 0xff, 0xff, 0xff,
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    0xff, 0xff, 0xff, 0xff, 0xff, 0xff, 0xff, 0xff, 0xff, 0xff, 0xff, 0xff, 0xff, 0xff, 0xff,
};

static const uint8_t qual_phase1[799] = {
    0x00, 0x00, 0x00, 0x00, 0x00, 0x00, 0x00, 0xef, 0xfe, 0xde, 0xfa, 0x7f, 0xff, 0xef, 0x7f, 0x7f,
    0xff, 0xed, 0xef, 0xdf, 0xff, 0x7f, 0x00, 0xff, 0xef, 0xed, 0xff, 0xff, 0xef, 0xff, 0xff, 0xff,
    0xff, 0xff, 0xff, 0xff, 0xff, 0xff, 0xff, 0xff, 0xff, 0xff, 0xff, 0xff, 0xff, 0xff, 0xff, 0xff,
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    0xff, 0xff, 0xff, 0xff, 0xff, 0xff, 0xff, 0xff, 0xff, 0xff, 0xff, 0xff, 0xff, 0xff, 0xff,
};

static const uint8_t restore_after_fast_color[799] = {
    0x00, 0x00, 0x00, 0x00, 0x00, 0x00, 0x00, 0xef, 0xf3, 0xf3, 0x7e, 0x7f, 0xff, 0xef, 0x3f, 0xaf,
    0xff, 0xef, 0xef, 0xf3, 0xff, 0x6f, 0x3f, 0xff, 0xef, 0xff, 0xff, 0xff, 0xff, 0xff, 0xff, 0xff,
    0xff, 0xff, 0xff, 0xff, 0xff, 0xff, 0xff, 0xff, 0xff, 0xff, 0xff, 0xff, 0xff, 0xff, 0xff, 0xff,
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    0xff, 0xff, 0xff, 0xff, 0xff, 0xff, 0xff, 0xff, 0xff, 0xff, 0xff, 0xff, 0xff, 0xff, 0xff,
};

static const uint8_t fast_color_phase2[799] = {
    0x00, 0x00, 0x00, 0x00, 0x00, 0x00, 0x00, 0xef, 0xff, 0xff, 0xfd, 0xff, 0xff, 0xef, 0xff, 0xff,
    0xff, 0xff, 0xff, 0xff, 0xff, 0xff, 0xff, 0xff, 0xff, 0xff, 0xff, 0xff, 0xff, 0xff, 0xff, 0xff,
    0xff, 0xff, 0xff, 0xff, 0xff, 0xff, 0xff, 0xff, 0xff, 0xff, 0xff, 0xff, 0xff, 0xff, 0xff, 0xff,
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    0xff, 0xff, 0xff, 0xff, 0xff, 0xff, 0xff, 0xff, 0xff, 0xff, 0xff, 0xff, 0xff, 0xff, 0xff,
};

static const uint8_t fast_color_phase1[799] = {
    0x00, 0x00, 0x00, 0x00, 0x00, 0x00, 0x00, 0xef, 0xf3, 0xff, 0xef, 0x6d, 0xff, 0xef, 0x24, 0xff,
    0xff, 0xef, 0xff, 0xff, 0xff, 0xff, 0xff, 0xff, 0xff, 0xff, 0xff, 0xff, 0xff, 0xff, 0xff, 0xff,
    0xff, 0xff, 0xff, 0xff, 0xff, 0xff, 0xff, 0xff, 0xff, 0xff, 0xff, 0xff, 0xff, 0xff, 0xff, 0xff,
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    0xff, 0xff, 0xff, 0xff, 0xff, 0xff, 0xff, 0xff, 0xff, 0xff, 0xff, 0xff, 0xff, 0xff, 0xff,
};

static const uint8_t mono_clear[799] = {
    0x00, 0x00, 0x00, 0x00, 0x00, 0x00, 0x00, 0xef, 0xff, 0xff, 0xfc, 0xff, 0xff, 0xef, 0xff, 0xff,
    0xff, 0xff, 0xff, 0xff, 0xff, 0xff, 0xff, 0xff, 0xff, 0xff, 0xff, 0xff, 0xff, 0xff, 0xff, 0xff,
    0xff, 0xff, 0xff, 0xff, 0xff, 0xff, 0xff, 0xff, 0xff, 0xff, 0xff, 0xff, 0xff, 0xff, 0xff, 0xff,
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    0xff, 0xff, 0xff, 0xff, 0xff, 0xff, 0xff, 0xff, 0xff, 0xff, 0xff, 0xff, 0xff, 0xff, 0xff,
};

static const uint8_t mono_fast[799] = {
    0x00, 0x00, 0x00, 0x00, 0x00, 0x00, 0x00, 0xef, 0xff, 0xff, 0xfd, 0xff, 0xff, 0xef, 0xff, 0xff,
    0xff, 0xff, 0xff, 0xff, 0xff, 0xff, 0xff, 0xff, 0xff, 0xff, 0xff, 0xff, 0xff, 0xff, 0xff, 0xff,
    0xff, 0xff, 0xff, 0xff, 0xff, 0xff, 0xff, 0xff, 0xff, 0xff, 0xff, 0xff, 0xff, 0xff, 0xff, 0xff,
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    0xff, 0xff, 0xff, 0xff, 0xff, 0xff, 0xff, 0xff, 0xff, 0xff, 0xff, 0xff, 0xff, 0xff, 0xff,
};

static const uint8_t full_clear[799] = {
    0x00, 0x00, 0x00, 0x00, 0x00, 0x00, 0x00, 0xef, 0xf3, 0xff, 0x7d, 0x7d, 0xff, 0xfd, 0xef, 0xff,
    0xff, 0xef, 0xff, 0xff, 0xff, 0xff, 0xff, 0xff, 0xff, 0xff, 0xff, 0xff, 0xff, 0xff, 0xff, 0xff,
    0xff, 0xff, 0xff, 0xff, 0xff, 0xff, 0xff, 0xff, 0xff, 0xff, 0xff, 0xff, 0xff, 0xff, 0xff, 0xff,
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    0xff, 0xff, 0xff, 0xff, 0xff, 0xff, 0xff, 0xff, 0xff, 0xff, 0xff, 0xff, 0xff, 0xff, 0xff,
};

// film 颜色表实际值 → JD7601 面板字节（DTM1 数据 4bpp 直写）
// 参考驱动颜色编码：黑0x00 白0x11 黄0x22 红0x33 蓝0x55 绿0x66
static const unsigned char color_lut[256] =
{
    [0x00] = 0x00, // Black
    [0xFF] = 0x01, // White
    [0xFC] = 0x02, // Yellow
    [0xE0] = 0x03, // Red
    [0x03] = 0x05, // Blue
    [0x1C] = 0x06, // Green
};

/*********************************************************************
 * LOCAL VARIABLES
 */
static spi_device_handle_t m_spi_device;
static bool m_busy_active_low = true;   // JD7601 BUSY 低电平表示忙（极性自适应）
static bool m_ignore_busy = false;      // BUSY 极性检测失败后忽略等待
static uint8_t m_spectra_state = 0;     // 48色状态机：0 native/qual, 1 clear, 2 mono, 3 fast-color
static bool m_mono_inited = false;      // 黑白快刷会话是否已初始化（跨调用保持上一帧）
static uint8_t m_mono_prev[EPD_MONO_BYTES];  // 黑白快刷上一帧（bit-reversed 存储）
static bool m_panel_powered = false;         // 面板 DC/DC 是否上电（PON 后、POF 前）；硬复位/深睡会清掉
static bool m_mono_session = false;          // 黑白快刷会话：打开时帧间保持上电（见 hal_epd_mono_session_begin）

/* Profiling owns only the two public mono/8bpp driver calls below. The existing
 * driver is serialized by its callers; internal helpers must not start a frame.
 * Stages are exclusive, including preparation passes, and retain original delays.
 * This measures driver calls, not decoding/UI/queue time or end-to-end FPS. */
#ifdef CONFIG_ARK_EPD_PROFILE
typedef enum {
    EPD_PROFILE_OTHER, EPD_PROFILE_INIT, EPD_PROFILE_LUT, EPD_PROFILE_RAM,
    EPD_PROFILE_REF, EPD_PROFILE_PON, EPD_PROFILE_POF, EPD_PROFILE_STAGE_COUNT
} epd_profile_stage_t;

static struct {
    bool active;
    const char *path;
    int64_t started_us;
    int64_t stage_us[EPD_PROFILE_STAGE_COUNT];
    epd_profile_stage_t stage;
    uint32_t bytes, lut_bytes, ram_bytes, ram_transactions, stages, timeouts, spi_errors;
    uint32_t call_id;
    esp_err_t first_error;
    bool first_prepare, mono_session, busy_ignored;
} m_profile;

/* PROFILE-only bounded statistics. Repeated begin calls do not reset them. */
#define EPD_PROFILE_SESSION_LIMIT 192
static struct {
    uint32_t samples, successful, errors, dropped, timeouts, spi_errors;
    int64_t first_started_us, last_started_us, total_sum, total_min, total_max;
    int64_t phase_sum[EPD_PROFILE_STAGE_COUNT];
    uint64_t bytes_sum, ram_bytes_sum, ram_transactions_sum, stages_sum;
    uint32_t intervals[EPD_PROFILE_SESSION_LIMIT - 1], interval_count;
} m_profile_session;

/* PROFILE-only observation. Call ids count Mono driver calls in this session,
 * not film indexes. Markers: 0=edge,1=begin,2=DTM1 before,3=DTM1 after,
 * 4=RAM done,5=REF before,6=REF+00 after,7=wait returned,8=tail returned,
 * 9=DTM1 BUSY wait returned. No marker drives refresh timing.
 * Five rolling slots retain four completed calls while another is in flight. */
#define EPD_BUSY_TRACE_LIMIT 80
#define EPD_BUSY_TAIL_SLOTS 5
#define EPD_BUSY_TAIL_EVENTS 20
typedef struct {
    uint32_t frame;
    int64_t origin_us;
    int initial_level;
    bool complete, overflow;
    uint8_t count;
    struct { int64_t us; uint8_t marker, level; } events[EPD_BUSY_TAIL_EVENTS];
} epd_busy_tail_t;
static DRAM_ATTR struct {
    bool session, active, installed, complete, overflow;
    int initial_level, end_level;
    int64_t end_us;
    esp_err_t registration_err;
    uint32_t frame;
    uint8_t early_frames, tail_head;
    uint16_t count;
    int64_t origin_us;
    struct { uint32_t us, frame; uint8_t marker, level; } events[EPD_BUSY_TRACE_LIMIT];
    epd_busy_tail_t tail[EPD_BUSY_TAIL_SLOTS];
} m_busy_trace;
static portMUX_TYPE m_busy_trace_mux = portMUX_INITIALIZER_UNLOCKED;
/* Shared by END's bounded JSON lines; never allocated on film_task's stack. */
static char m_profile_line[4096];

static void IRAM_ATTR epd_busy_trace_record(uint8_t marker)
{
    portENTER_CRITICAL_ISR(&m_busy_trace_mux);
    if (m_busy_trace.active) {
        const int64_t now = esp_timer_get_time();
        const uint8_t level = gpio_ll_get_level(&GPIO, EPD_BUSY_PIN);
        if (!m_busy_trace.complete && !m_busy_trace.overflow) {
            if (m_busy_trace.count < EPD_BUSY_TRACE_LIMIT) {
                const unsigned i = m_busy_trace.count++;
                m_busy_trace.events[i].us = (uint32_t)(now - m_busy_trace.origin_us);
                m_busy_trace.events[i].frame = m_busy_trace.frame;
                m_busy_trace.events[i].marker = marker;
                m_busy_trace.events[i].level = level;
            } else {
                m_busy_trace.overflow = true;
            }
        }
        epd_busy_tail_t *slot = &m_busy_trace.tail[m_busy_trace.tail_head];
        if (slot->count < EPD_BUSY_TAIL_EVENTS) {
            const unsigned i = slot->count++;
            slot->events[i].us = now;
            slot->events[i].marker = marker;
            slot->events[i].level = level;
        } else {
            slot->overflow = true;
        }
    }
    portEXIT_CRITICAL_ISR(&m_busy_trace_mux);
}

static void IRAM_ATTR epd_busy_trace_isr(void *arg)
{
    (void)arg;
    epd_busy_trace_record(0);
}

/* Stop before POF, without logging. Shared GPIO service remains installed. */
static void epd_busy_trace_stop(void)
{
    portENTER_CRITICAL(&m_busy_trace_mux);
    if (m_busy_trace.active) {
        m_busy_trace.end_us = esp_timer_get_time();
        m_busy_trace.end_level = gpio_ll_get_level(&GPIO, EPD_BUSY_PIN);
        m_busy_trace.active = false;
    }
    portEXIT_CRITICAL(&m_busy_trace_mux);
    if (!m_busy_trace.installed) return;
    gpio_intr_disable(EPD_BUSY_PIN);
    gpio_isr_handler_remove(EPD_BUSY_PIN);
    gpio_set_intr_type(EPD_BUSY_PIN, GPIO_INTR_DISABLE);
    m_busy_trace.installed = false;
}

static void epd_busy_trace_frame(uint32_t frame)
{
    if (!m_busy_trace.session || m_busy_trace.registration_err) return;
    if (!m_busy_trace.installed) {
        /* GPIO11 is exclusively EPD BUSY. Reuse the SD/button ISR service. */
        esp_err_t err = gpio_install_isr_service(ESP_INTR_FLAG_IRAM);
        if (err == ESP_ERR_INVALID_STATE) err = ESP_OK;
        if (err == ESP_OK) err = gpio_set_intr_type(EPD_BUSY_PIN, GPIO_INTR_ANYEDGE);
        if (err == ESP_OK) err = gpio_isr_handler_add(EPD_BUSY_PIN, epd_busy_trace_isr, NULL);
        m_busy_trace.registration_err = err;
        if (err != ESP_OK) {
            gpio_set_intr_type(EPD_BUSY_PIN, GPIO_INTR_DISABLE);
            return;
        }
        m_busy_trace.installed = true;
    }
    portENTER_CRITICAL(&m_busy_trace_mux);
    if (m_busy_trace.frame)
        m_busy_trace.tail_head = (m_busy_trace.tail_head + 1) % EPD_BUSY_TAIL_SLOTS;
    const int64_t now = esp_timer_get_time();
    const int level = gpio_ll_get_level(&GPIO, EPD_BUSY_PIN);
    if (!m_busy_trace.frame) {
        m_busy_trace.initial_level = level;
        m_busy_trace.origin_us = now;
    }
    m_busy_trace.frame = frame;
    epd_busy_tail_t *slot = &m_busy_trace.tail[m_busy_trace.tail_head];
    slot->frame = frame;
    slot->origin_us = now;
    slot->initial_level = level;
    slot->count = 0;
    slot->complete = slot->overflow = false;
    if (m_busy_trace.early_frames < 5) m_busy_trace.early_frames++;
    m_busy_trace.active = true;
    portEXIT_CRITICAL(&m_busy_trace_mux);
    epd_busy_trace_record(1);
    portENTER_CRITICAL(&m_busy_trace_mux);
    if (m_busy_trace.early_frames == 5) m_busy_trace.complete = true;
    portEXIT_CRITICAL(&m_busy_trace_mux);
}

static void epd_busy_trace_call_end(uint32_t frame)
{
    portENTER_CRITICAL(&m_busy_trace_mux);
    epd_busy_tail_t *slot = &m_busy_trace.tail[m_busy_trace.tail_head];
    if (slot->frame == frame && frame) slot->complete = true;
    portEXIT_CRITICAL(&m_busy_trace_mux);
}

static void epd_busy_trace_end(void)
{
    if (!m_busy_trace.session) return;
    epd_busy_trace_stop();
    char *line = m_profile_line;
    size_t n = (size_t)snprintf(line, sizeof(m_profile_line),
        "{\"window\":\"early\",\"initial_level\":%d,\"registration_err\":%d,\"overflow\":%s,"
        "\"capture_complete\":%s,\"origin_us\":%" PRId64 ",\"events\":[",
        m_busy_trace.initial_level, (int)m_busy_trace.registration_err,
        m_busy_trace.overflow ? "true" : "false",
        m_busy_trace.complete && !m_busy_trace.registration_err && !m_busy_trace.overflow ? "true" : "false",
        m_busy_trace.origin_us);
    for (unsigned i = 0; i < m_busy_trace.count; i++) {
        n += (size_t)snprintf(line + n, sizeof(m_profile_line) - n,
            "%s[%" PRIu32 ",%" PRIu32 ",%u,%u]", i ? "," : "",
            m_busy_trace.events[i].us, m_busy_trace.events[i].frame,
            m_busy_trace.events[i].marker, m_busy_trace.events[i].level);
    }
    snprintf(line + n, sizeof(m_profile_line) - n, "]}");
    sys_logi(EPD_TAG, "EPD_BUSY_TRACE %s", line);

    unsigned selected[4], count = 0;
    for (int back = EPD_BUSY_TAIL_SLOTS - 1; back >= 0; back--) {
        const unsigned index = (m_busy_trace.tail_head + EPD_BUSY_TAIL_SLOTS - back) % EPD_BUSY_TAIL_SLOTS;
        if (!m_busy_trace.tail[index].frame || !m_busy_trace.tail[index].complete) continue;
        if (count == 4) {
            for (unsigned i = 1; i < 4; i++) selected[i - 1] = selected[i];
            count--;
        }
        selected[count++] = index;
    }
    bool overflow = false;
    for (unsigned i = 0; i < count; i++) overflow |= m_busy_trace.tail[selected[i]].overflow;
    const int64_t origin = count ? m_busy_trace.tail[selected[0]].origin_us : 0;
    const epd_busy_tail_t *current = &m_busy_trace.tail[m_busy_trace.tail_head];
    const uint32_t partial = current->frame && !current->complete ? current->frame : 0;
    n = (size_t)snprintf(line, sizeof(m_profile_line),
        "{\"window\":\"tail\",\"initial_level\":%d,\"registration_err\":%d,\"overflow\":%s,"
        "\"capture_complete\":%s,\"partial_frame\":%" PRIu32 ",\"partial_overflow\":%s,"
        "\"origin_us\":%" PRId64 ",\"end_us\":%" PRId64 ",\"end_level\":%d,\"frames\":[",
        count ? m_busy_trace.tail[selected[0]].initial_level : -1,
        (int)m_busy_trace.registration_err, overflow ? "true" : "false",
        count == 4 && !overflow && !m_busy_trace.registration_err ? "true" : "false",
        partial, partial && current->overflow ? "true" : "false", origin,
        origin ? m_busy_trace.end_us - origin : 0, m_busy_trace.end_level);
    for (unsigned i = 0; i < count; i++) {
        const epd_busy_tail_t *slot = &m_busy_trace.tail[selected[i]];
        n += (size_t)snprintf(line + n, sizeof(m_profile_line) - n,
            "%s{\"frame\":%" PRIu32 ",\"initial_level\":%d,\"overflow\":%s,\"events\":[",
            i ? "," : "", slot->frame, slot->initial_level, slot->overflow ? "true" : "false");
        for (unsigned j = 0; j < slot->count; j++) {
            n += (size_t)snprintf(line + n, sizeof(m_profile_line) - n,
                "%s[%" PRId64 ",%u,%u]", j ? "," : "", slot->events[j].us - origin,
                slot->events[j].marker, slot->events[j].level);
        }
        n += (size_t)snprintf(line + n, sizeof(m_profile_line) - n, "]}");
    }
    snprintf(line + n, sizeof(m_profile_line) - n, "]}");
    sys_logi(EPD_TAG, "EPD_BUSY_TRACE %s", line);
    memset(&m_busy_trace, 0, sizeof(m_busy_trace));
}

#define EPD_MONO_RECENT_LIMIT 8
static struct {
    uint32_t calls, count, next, call_errors, call_timeouts, call_spi_errors;
    struct {
        uint32_t frame, stages, timeouts, spi_errors;
        int64_t started_us, total_us, ram_us, ref_us;
        bool first_prepare, ok;
    } recent[EPD_MONO_RECENT_LIMIT];
    uint32_t steady_count, successful, errors, timeouts, spi_errors;
    int64_t first_started_us, last_started_us, total_sum_us;
    int64_t phase_sum[EPD_PROFILE_STAGE_COUNT];
    int64_t min_ref_us, min_ref_started_us;
    uint32_t min_ref_frame;
} m_mono_recent;

static void epd_mono_recent_add(int64_t total, int64_t other, bool ok, bool steady)
{
    if (!m_profile.call_id) return;
    m_mono_recent.call_errors += !ok;
    m_mono_recent.call_timeouts += m_profile.timeouts;
    m_mono_recent.call_spi_errors += m_profile.spi_errors;
    const unsigned i = m_mono_recent.next;
    m_mono_recent.recent[i].frame = m_profile.call_id;
    m_mono_recent.recent[i].started_us = m_profile.started_us;
    m_mono_recent.recent[i].total_us = total;
    m_mono_recent.recent[i].ram_us = m_profile.stage_us[EPD_PROFILE_RAM];
    m_mono_recent.recent[i].ref_us = m_profile.stage_us[EPD_PROFILE_REF];
    m_mono_recent.recent[i].stages = m_profile.stages;
    m_mono_recent.recent[i].first_prepare = m_profile.first_prepare;
    m_mono_recent.recent[i].ok = ok;
    m_mono_recent.recent[i].timeouts = m_profile.timeouts;
    m_mono_recent.recent[i].spi_errors = m_profile.spi_errors;
    m_mono_recent.next = (i + 1) % EPD_MONO_RECENT_LIMIT;
    if (m_mono_recent.count < EPD_MONO_RECENT_LIMIT) m_mono_recent.count++;
    if (!steady) return;
    if (!m_mono_recent.steady_count) m_mono_recent.first_started_us = m_profile.started_us;
    m_mono_recent.last_started_us = m_profile.started_us;
    m_mono_recent.steady_count++;
    m_mono_recent.timeouts += m_profile.timeouts;
    m_mono_recent.spi_errors += m_profile.spi_errors;
    if (!ok) {
        m_mono_recent.errors++;
        return;
    }
    if (!m_mono_recent.successful || m_profile.stage_us[EPD_PROFILE_REF] < m_mono_recent.min_ref_us) {
        m_mono_recent.min_ref_us = m_profile.stage_us[EPD_PROFILE_REF];
        m_mono_recent.min_ref_frame = m_profile.call_id;
        m_mono_recent.min_ref_started_us = m_profile.started_us;
    }
    m_mono_recent.successful++;
    m_mono_recent.total_sum_us += total;
    for (unsigned j = 0; j < EPD_PROFILE_STAGE_COUNT; j++)
        m_mono_recent.phase_sum[j] += j == EPD_PROFILE_OTHER ? other : m_profile.stage_us[j];
}

static void epd_mono_recent_end(void)
{
    char *line = m_profile_line;
    size_t n = (size_t)snprintf(line, sizeof(m_profile_line),
        "{\"unit\":\"us\",\"calls_seen\":%" PRIu32 ",\"errors\":%" PRIu32 ",\"timeouts\":%" PRIu32 ",\"spi_errors\":%" PRIu32 ",\"calls\":[",
        m_mono_recent.calls, m_mono_recent.call_errors, m_mono_recent.call_timeouts, m_mono_recent.call_spi_errors);
    for (unsigned i = 0; i < m_mono_recent.count; i++) {
        const unsigned j = (m_mono_recent.next + EPD_MONO_RECENT_LIMIT - m_mono_recent.count + i) % EPD_MONO_RECENT_LIMIT;
        n += (size_t)snprintf(line + n, sizeof(m_profile_line) - n,
            "%s[%" PRIu32 ",%" PRId64 ",%" PRId64 ",%" PRId64 ",%" PRId64 ",%" PRIu32 ",%s,%s,%" PRIu32 ",%" PRIu32 "]",
            i ? "," : "", m_mono_recent.recent[j].frame, m_mono_recent.recent[j].started_us,
            m_mono_recent.recent[j].total_us, m_mono_recent.recent[j].ram_us, m_mono_recent.recent[j].ref_us,
            m_mono_recent.recent[j].stages, m_mono_recent.recent[j].first_prepare ? "true" : "false",
            m_mono_recent.recent[j].ok ? "true" : "false", m_mono_recent.recent[j].timeouts,
            m_mono_recent.recent[j].spi_errors);
    }
    n += (size_t)snprintf(line + n, sizeof(m_profile_line) - n,
        "],\"steady\":{\"count\":%" PRIu32 ",\"ok_count\":%" PRIu32 ",\"errors\":%" PRIu32 ","
        "\"timeouts\":%" PRIu32 ",\"spi_errors\":%" PRIu32 ",\"first_started_us\":%" PRId64 ","
        "\"last_started_us\":%" PRId64 ",\"total_sum_us\":%" PRId64 ",\"phase_sum_us\":[",
        m_mono_recent.steady_count, m_mono_recent.successful, m_mono_recent.errors,
        m_mono_recent.timeouts, m_mono_recent.spi_errors, m_mono_recent.first_started_us,
        m_mono_recent.last_started_us, m_mono_recent.total_sum_us);
    for (unsigned i = 0; i < EPD_PROFILE_STAGE_COUNT; i++)
        n += (size_t)snprintf(line + n, sizeof(m_profile_line) - n,
            "%s%" PRId64, i ? "," : "", m_mono_recent.phase_sum[i]);
    snprintf(line + n, sizeof(m_profile_line) - n,
        "],\"min_ref_us\":%" PRId64 ",\"min_ref_frame\":%" PRIu32 ",\"min_ref_started_us\":%" PRId64 "}}",
        m_mono_recent.min_ref_us, m_mono_recent.min_ref_frame, m_mono_recent.min_ref_started_us);
    sys_logi(EPD_TAG, "EPD_MONO_RECENT %s", line);
    memset(&m_mono_recent, 0, sizeof(m_mono_recent));
}

static int epd_profile_interval_compare(const void *a, const void *b)
{
    const uint32_t x = *(const uint32_t *)a, y = *(const uint32_t *)b;
    return (x > y) - (x < y);
}

static void epd_profile_session_begin(void)
{
    memset(&m_profile_session, 0, sizeof(m_profile_session));
    memset(&m_mono_recent, 0, sizeof(m_mono_recent));
    memset(&m_busy_trace, 0, sizeof(m_busy_trace));
    m_busy_trace.session = true;
    m_busy_trace.initial_level = m_busy_trace.end_level = -1;
}

static void epd_profile_session_end(void)
{
    const bool had_session = m_busy_trace.session;
    epd_busy_trace_end();
    if (had_session) epd_mono_recent_end();
    if (m_profile_session.samples || m_profile_session.dropped) {
        const uint32_t n = m_profile_session.interval_count;
        uint64_t interval_sum = 0;
        for (uint32_t i = 0; i < n; i++) interval_sum += m_profile_session.intervals[i];
        qsort(m_profile_session.intervals, n, sizeof(uint32_t), epd_profile_interval_compare);
        const double median = n ? ((double)m_profile_session.intervals[(n - 1) / 2]
                                  + m_profile_session.intervals[n / 2]) / 2 : 0;
        ESP_LOGI(EPD_TAG, "EPD_PROFILE_SESSION {\"path\":\"mono\",\"scope\":\"mono_session\",\"unit\":\"us\","
                 "\"sample_count\":%" PRIu32 ",\"ok_samples\":%" PRIu32 ",\"error_samples\":%" PRIu32 ",\"dropped_samples\":%" PRIu32 ","
                 "\"first_started_us\":%" PRId64 ",\"last_started_us\":%" PRId64 ","
                 "\"total_sum_us\":%" PRId64 ",\"total_min_us\":%" PRId64 ",\"total_max_us\":%" PRId64 ","
                 "\"sum_us\":{\"init_us\":%" PRId64 ",\"lut_us\":%" PRId64 ",\"ram_us\":%" PRId64 ","
                 "\"ref_us\":%" PRId64 ",\"pon_us\":%" PRId64 ",\"pof_us\":%" PRId64 ",\"other_us\":%" PRId64 "},"
                 "\"bytes_sum\":%" PRIu64 ",\"ram_bytes_sum\":%" PRIu64 ",\"ram_transactions_sum\":%" PRIu64 ",\"stages_sum\":%" PRIu64 ","
                 "\"interval_count\":%" PRIu32 ",\"interval_min_us\":%" PRIu32 ",\"interval_p50_us\":%.1f,"
                 "\"interval_max_us\":%" PRIu32 ",\"interval_sum_us\":%" PRIu64 ","
                 "\"timeouts\":%" PRIu32 ",\"spi_errors\":%" PRIu32 ",\"ok\":%s}",
                 m_profile_session.samples, m_profile_session.successful, m_profile_session.errors, m_profile_session.dropped,
                 m_profile_session.first_started_us, m_profile_session.last_started_us,
                 m_profile_session.total_sum, m_profile_session.total_min, m_profile_session.total_max,
                 m_profile_session.phase_sum[EPD_PROFILE_INIT], m_profile_session.phase_sum[EPD_PROFILE_LUT],
                 m_profile_session.phase_sum[EPD_PROFILE_RAM], m_profile_session.phase_sum[EPD_PROFILE_REF],
                 m_profile_session.phase_sum[EPD_PROFILE_PON], m_profile_session.phase_sum[EPD_PROFILE_POF],
                 m_profile_session.phase_sum[EPD_PROFILE_OTHER],
                 m_profile_session.bytes_sum, m_profile_session.ram_bytes_sum,
                 m_profile_session.ram_transactions_sum, m_profile_session.stages_sum,
                 n, n ? m_profile_session.intervals[0] : 0, median,
                 n ? m_profile_session.intervals[n - 1] : 0, interval_sum,
                 m_profile_session.timeouts, m_profile_session.spi_errors,
                 m_profile_session.errors ? "false" : "true");
    }
    memset(&m_profile_session, 0, sizeof(m_profile_session));
}

static void epd_profile_session_add(int64_t total_us, int64_t other_us, bool ok)
{
    /* Errors cover all calls, even past capacity; sums cover retained good calls. */
    m_profile_session.timeouts += m_profile.timeouts;
    m_profile_session.spi_errors += m_profile.spi_errors;
    if (!ok) m_profile_session.errors++;
    if (m_profile_session.samples == EPD_PROFILE_SESSION_LIMIT) {
        m_profile_session.dropped++;
        return;
    }
    if (m_profile_session.samples) {
        const int64_t elapsed = m_profile.started_us - m_profile_session.last_started_us;
        m_profile_session.intervals[m_profile_session.interval_count++] =
            elapsed > UINT32_MAX ? UINT32_MAX : (uint32_t)elapsed;
    } else {
        m_profile_session.first_started_us = m_profile.started_us;
    }
    m_profile_session.last_started_us = m_profile.started_us;
    m_profile_session.samples++;
    if (!ok) return;
    if (!m_profile_session.successful || total_us < m_profile_session.total_min)
        m_profile_session.total_min = total_us;
    if (total_us > m_profile_session.total_max) m_profile_session.total_max = total_us;
    m_profile_session.successful++;
    m_profile_session.total_sum += total_us;
    for (int i = EPD_PROFILE_INIT; i < EPD_PROFILE_STAGE_COUNT; i++)
        m_profile_session.phase_sum[i] += m_profile.stage_us[i];
    m_profile_session.phase_sum[EPD_PROFILE_OTHER] += other_us;
    m_profile_session.bytes_sum += m_profile.bytes;
    m_profile_session.ram_bytes_sum += m_profile.ram_bytes;
    m_profile_session.ram_transactions_sum += m_profile.ram_transactions;
    m_profile_session.stages_sum += m_profile.stages;
}

static void epd_profile_begin(const char *path)
{
    memset(&m_profile, 0, sizeof(m_profile));
    m_profile.path = path;
    m_profile.mono_session = m_mono_session;
    m_profile.busy_ignored = m_ignore_busy;
    m_profile.active = true;
    m_profile.started_us = esp_timer_get_time();
    if (m_mono_session && !strcmp(path, "mono")) {
        m_profile.call_id = ++m_mono_recent.calls;
        if (m_profile_session.samples) epd_busy_trace_frame(m_profile.call_id);
    }
}

static int64_t epd_profile_stage_begin(epd_profile_stage_t stage)
{
    if (!m_profile.active) return 0;
    m_profile.stage = stage;
    return esp_timer_get_time();
}

static void epd_profile_stage_end(epd_profile_stage_t stage, int64_t started_us)
{
    if (!m_profile.active) return;
    m_profile.stage_us[stage] += esp_timer_get_time() - started_us;
    m_profile.stage = EPD_PROFILE_OTHER;
}

static void epd_profile_error(esp_err_t err, bool timeout)
{
    if (!m_profile.active) return;
    if (m_profile.first_error == ESP_OK) m_profile.first_error = err;
    if (timeout) m_profile.timeouts++;
}

static void epd_profile_spi(esp_err_t err, uint32_t bytes, bool payload)
{
    if (!m_profile.active) return;
    if (err != ESP_OK) {
        m_profile.spi_errors++;
        epd_profile_error(err, false);
        return;
    }
    m_profile.bytes += bytes;
    if (payload && m_profile.stage == EPD_PROFILE_LUT) m_profile.lut_bytes += bytes;
    if (payload && m_profile.stage == EPD_PROFILE_RAM) {
        m_profile.ram_bytes += bytes;
        m_profile.ram_transactions++;
    }
}

static void epd_profile_end(void)
{
    const int64_t total_us = esp_timer_get_time() - m_profile.started_us;
    int64_t other_us = total_us;
    for (int i = EPD_PROFILE_INIT; i < EPD_PROFILE_STAGE_COUNT; i++)
        other_us -= m_profile.stage_us[i];
    const bool ok = m_profile.first_error == ESP_OK && !m_profile.busy_ignored;
    m_profile.active = false;  /* Serial logging is outside the timed call. */
    const bool steady = m_profile.mono_session && !strcmp(m_profile.path, "mono") &&
        !m_profile.first_prepare && !m_profile.stage_us[EPD_PROFILE_INIT] &&
        !m_profile.stage_us[EPD_PROFILE_PON];
    if (m_profile.call_id) {
        epd_mono_recent_add(total_us, other_us, ok, steady);
        epd_busy_trace_call_end(m_profile.call_id);
    }
    if (steady) {
        epd_profile_session_add(total_us, other_us, ok);
        return;
    }
    ESP_LOGI(EPD_TAG, "EPD_PROFILE {\"path\":\"%s\",\"scope\":\"driver_call\",\"unit\":\"us\","
             "\"started_us\":%" PRId64 ",\"total_us\":%" PRId64 ","
             "\"init_us\":%" PRId64 ",\"lut_us\":%" PRId64 ",\"ram_us\":%" PRId64 ","
             "\"ref_us\":%" PRId64 ",\"pon_us\":%" PRId64 ",\"pof_us\":%" PRId64 ",\"other_us\":%" PRId64 ","
             "\"bytes\":%" PRIu32 ",\"lut_bytes\":%" PRIu32 ",\"ram_bytes\":%" PRIu32 ","
             "\"ram_transactions\":%" PRIu32 ",\"stages\":%" PRIu32 ",\"first_prepare\":%s,\"mono_session\":%s,"
             "\"timeouts\":%" PRIu32 ",\"spi_errors\":%" PRIu32 ",\"first_error\":%d,"
             "\"busy_ignored\":%s,\"ok\":%s}",
             m_profile.path, m_profile.started_us, total_us,
             m_profile.stage_us[EPD_PROFILE_INIT], m_profile.stage_us[EPD_PROFILE_LUT],
             m_profile.stage_us[EPD_PROFILE_RAM], m_profile.stage_us[EPD_PROFILE_REF],
             m_profile.stage_us[EPD_PROFILE_PON], m_profile.stage_us[EPD_PROFILE_POF], other_us,
             m_profile.bytes, m_profile.lut_bytes, m_profile.ram_bytes,
             m_profile.ram_transactions, m_profile.stages,
             m_profile.first_prepare ? "true" : "false", m_profile.mono_session ? "true" : "false",
             m_profile.timeouts, m_profile.spi_errors, (int)m_profile.first_error,
             m_profile.busy_ignored ? "true" : "false", ok ? "true" : "false");
}

#define EPD_BUSY_TRACE(marker) epd_busy_trace_record(marker)
#define EPD_PROFILE_SESSION_STOP() epd_busy_trace_stop()
#define EPD_PROFILE_SESSION_BEGIN() epd_profile_session_begin()
#define EPD_PROFILE_SESSION_END() epd_profile_session_end()
#define EPD_PROFILE_BEGIN(path) epd_profile_begin(path)
#define EPD_PROFILE_END() epd_profile_end()
#define EPD_PROFILE_STAGE_BEGIN(name) \
    const int64_t profile_##name##_started_us = epd_profile_stage_begin(EPD_PROFILE_##name)
#define EPD_PROFILE_STAGE_END(name) \
    epd_profile_stage_end(EPD_PROFILE_##name, profile_##name##_started_us)
#define EPD_PROFILE_SPI(call, bytes, payload) epd_profile_spi((call), (bytes), (payload))
#define EPD_PROFILE_ERROR(err) epd_profile_error((err), false)
#define EPD_PROFILE_TIMEOUT() epd_profile_error(ESP_ERR_TIMEOUT, true)
#define EPD_PROFILE_PREPARE() do { if (m_profile.active) m_profile.first_prepare = true; } while (0)
#define EPD_PROFILE_REF_COUNT() do { if (m_profile.active) m_profile.stages++; } while (0)
#else
#define EPD_BUSY_TRACE(marker) ((void)0)
#define EPD_PROFILE_SESSION_STOP() ((void)0)
#define EPD_PROFILE_SESSION_BEGIN() ((void)0)
#define EPD_PROFILE_SESSION_END() ((void)0)
#define EPD_PROFILE_BEGIN(path) ((void)0)
#define EPD_PROFILE_END() ((void)0)
#define EPD_PROFILE_STAGE_BEGIN(name) ((void)0)
#define EPD_PROFILE_STAGE_END(name) ((void)0)
#define EPD_PROFILE_SPI(call, bytes, payload) ((void)(call))
#define EPD_PROFILE_ERROR(err) ((void)0)
#define EPD_PROFILE_TIMEOUT() ((void)0)
#define EPD_PROFILE_PREPARE() ((void)0)
#define EPD_PROFILE_REF_COUNT() ((void)0)
#endif

/*********************************************************************
 * LOCAL FUNCTIONS
 */
static void spi_init(void);
static void EPD_W21_WriteCMD(unsigned char command);
static void EPD_W21_WriteDATA(unsigned char datas);
static void EPD_W21_WriteDATA_Bulk(const unsigned char *data, uint32_t len);
static bool epd_wait_busy(uint32_t timeout_ms);
static void epd_try_fix_busy_polarity(void);
static void reset(void);
static esp_err_t film_parse_header(const unsigned char *filmData, FilmHeader *header);
static void epd_display_refresh_seq(void);
static void epd_display_solid(unsigned char color_byte);
static void epd_spectra_wave(const uint8_t *lut);
static void epd_spectra_init(void);
static void epd_spectra_power_off(void);
static void epd_spectra_refresh(bool power_on, bool power_off);
static void epd_spectra_wait_cycle(uint32_t assert_timeout_ms, uint32_t release_timeout_ms);
static void epd_spectra_fill(uint8_t fill_byte);
static void epd_spectra_full_clear(void);
static void epd_spectra_encode_row(const uint8_t *row, uint8_t plane, uint8_t *out);
static void epd_spectra_write_plane(const uint8_t *index8, uint8_t plane);
static void epd_spectra_display_color(const uint8_t *index8, uint8_t mode);
static uint8_t epd_spectra_reverse_bits(uint8_t x);
static void epd_spectra_prepare(void);
static void epd_spectra_mono_write(const uint8_t *mono_bitmap);
static void epd_spectra_mono_display(const uint8_t *mono_bitmap, bool is_clear);

/*********************************************************************
 * HARDWARE SPI (half-duplex, 3-wire mode)
 *********************************************************************/

static void spi_init(void)
{
    esp_err_t ret;

    spi_bus_config_t buscfg =
    {
        .miso_io_num = -1,
        .mosi_io_num = EPD_SDIN_PIN,
        .sclk_io_num = EPD_SCK_PIN,
        .quadwp_io_num = -1,
        .quadhd_io_num = -1,
        .max_transfer_sz = EPD_INPUT_LINE * 4
    };

    ret = spi_bus_initialize(EPD_SPI_HOST, &buscfg, SPI_DMA_CH_AUTO);
    assert(ret == ESP_OK);

    spi_device_interface_config_t devcfg =
    {
        /* mono 全帧单次要推 172800 字节，10MHz 需 138ms，是刷新率的第一瓶颈；
           40MHz 降到约 35ms。若出现花屏/丢帧请回退到 20MHz（见 docs/knowledge/ui_layer.md）。 */
        .clock_speed_hz = 40000000,
        .mode = 0,
        .spics_io_num = -1,
        .queue_size = 1,
        .flags = SPI_DEVICE_HALFDUPLEX | SPI_DEVICE_3WIRE,
    };

    ret = spi_bus_add_device(EPD_SPI_HOST, &devcfg, &m_spi_device);
    assert(ret == ESP_OK);
}

static void EPD_W21_WriteCMD(unsigned char command)
{
    EPD_W21_CS_0;
    EPD_W21_DC_0;
    spi_transaction_t t;
    memset(&t, 0, sizeof(t));
    t.length = 8;
    t.tx_buffer = &command;
    EPD_PROFILE_SPI(spi_device_transmit(m_spi_device, &t), 1, false);
    EPD_W21_CS_1;
}

static void EPD_W21_WriteDATA(unsigned char datas)
{
    EPD_W21_CS_0;
    EPD_W21_DC_1;
    spi_transaction_t t;
    memset(&t, 0, sizeof(t));
    t.length = 8;
    t.tx_buffer = &datas;
    EPD_PROFILE_SPI(spi_device_transmit(m_spi_device, &t), 1, false);
    EPD_W21_CS_1;
}

static void EPD_W21_WriteDATA_Bulk(const unsigned char *data, uint32_t len)
{
    EPD_W21_CS_0;
    EPD_W21_DC_1;
    spi_transaction_t t;
    memset(&t, 0, sizeof(t));
    t.length = len * 8;
    t.tx_buffer = data;
    EPD_PROFILE_SPI(spi_device_transmit(m_spi_device, &t), len, true);
    EPD_W21_CS_1;
}

/*********************************************************************
 * HELPER FUNCTIONS
 *********************************************************************/

static bool epd_wait_busy(uint32_t timeout_ms)
{
    if (m_ignore_busy)
    {
        return true;
    }

    TickType_t start = xTaskGetTickCount();
    int busy_level = m_busy_active_low ? 0 : 1;

    while (gpio_get_level(EPD_BUSY_PIN) == busy_level)
    {
        vTaskDelay(pdMS_TO_TICKS(1));
        if (((xTaskGetTickCount() - start) * portTICK_PERIOD_MS) > timeout_ms)
        {
            sys_logw(EPD_TAG, "wait busy timeout (active_low=%d)", m_busy_active_low ? 1 : 0);
            EPD_PROFILE_TIMEOUT();
            return false;
        }
    }
    return true;
}

static void epd_try_fix_busy_polarity(void)
{
    if (epd_wait_busy(BUSY_TIMEOUT_POLARITY_MS))
    {
        sys_logi(EPD_TAG, "BUSY polarity ok (active_low=%d)", m_busy_active_low ? 1 : 0);
        return;
    }

    m_busy_active_low = !m_busy_active_low;
    if (epd_wait_busy(BUSY_TIMEOUT_POLARITY_MS))
    {
        sys_logi(EPD_TAG, "BUSY polarity switched (active_low=%d)", m_busy_active_low ? 1 : 0);
    }
    else
    {
        sys_logw(EPD_TAG, "BUSY polarity detection failed, ignore BUSY and continue");
        m_ignore_busy = true;
    }
}

static void reset(void)
{
    EPD_W21_RST_0;
    vTaskDelay(20 / portTICK_PERIOD_MS);
    EPD_W21_RST_1;
    vTaskDelay(20 / portTICK_PERIOD_MS);
    epd_wait_busy(BUSY_TIMEOUT_INIT_MS);
    vTaskDelay(10 / portTICK_PERIOD_MS);

    /* 硬复位会清掉控制器内的帧数据，mono 差分刷新必须以复位后的状态重新建立会话，
       否则会拿失效的上一帧做差分（整屏闪/花屏）。 */
    m_mono_inited = false;
    m_panel_powered = false;   // 复位后面板回到未上电态
}

/*********************************************************************
 * NAME:        film_parse_header
 * DESCRIPTION: 解析并校验 .film 文件头。按 Format 得出单帧主体大小，
 *              再按 FrameCount（0/1 视为单帧）校验总主体大小。
 *********************************************************************/
static esp_err_t film_parse_header(const unsigned char *filmData, FilmHeader *header)
{
    if (filmData == NULL || header == NULL)
    {
        return ESP_ERR_INVALID_ARG;
    }

    memcpy(&header->fileSize,     &filmData[FILM_OFFSET_FILESIZE],      sizeof(uint32_t));
    memcpy(&header->screenWidth,  &filmData[FILM_OFFSET_SCREENWIDTH],   sizeof(uint16_t));
    memcpy(&header->screenHeight, &filmData[FILM_OFFSET_SCREENHEIGHT],  sizeof(uint16_t));
    memcpy(&header->colorCount,   &filmData[FILM_OFFSET_COLORCOUNT],    sizeof(uint8_t));
    memcpy(&header->format,       &filmData[FILM_OFFSET_FORMAT],        sizeof(uint8_t));
    memcpy(&header->frameCount,   &filmData[FILM_OFFSET_FRAMECOUNT],    sizeof(uint16_t));
    memcpy(header->reserved,      &filmData[FILM_OFFSET_RESERVED],      sizeof(header->reserved));
    memcpy(header->colorTable,    &filmData[FILM_OFFSET_COLORTABLE],    FILM_COLOR_TABLE_SIZE);

    // 按 Format（偏移 0x09）判别 v1/v2 编码方式，得出单帧主体大小
    uint32_t frameSize;
    switch (header->format)
    {
    case 0x00:  // v1：4bpp 颜色编码，ColorCount 取值 2-6
        if (header->colorCount < 2 || header->colorCount > 6)
        {
            sys_loge(EPD_TAG, "Invalid color count: %d (expected 2-6)", header->colorCount);
            return ESP_ERR_INVALID_SIZE;
        }
        frameSize = (EPD_WIDTH * EPD_HEIGHT) / 2;
        break;

    case 0x01:  // v2 MonoFast：1bpp 位图
        frameSize = (EPD_WIDTH * EPD_HEIGHT) / 8;
        break;

    case 0x02:  // v2 ColorQual：8bpp 索引
    case 0x03:  // v2 ColorFast：8bpp 索引
        frameSize = EPD_WIDTH * EPD_HEIGHT;
        break;

    default:
        sys_loge(EPD_TAG, "Unknown film format: 0x%02X", header->format);
        return ESP_ERR_INVALID_VERSION;
    }

    // FrameCount：0/1 视为单帧；>1 为多帧动画，主体按帧连续拼接
    uint32_t frameCount = (header->frameCount == 0) ? 1u : header->frameCount;
    uint32_t expectedSize = frameSize * frameCount;

    if (header->fileSize != expectedSize)
    {
        sys_loge(EPD_TAG, "File size mismatch: %lu (expected %lu, %u frame(s))",
                 (unsigned long)header->fileSize, (unsigned long)expectedSize,
                 (unsigned)frameCount);
        return ESP_ERR_INVALID_SIZE;
    }

    return ESP_OK;
}

// 写完整帧数据（4bpp，DTM1）
static void epd_display_refresh_seq(void)
{
    EPD_W21_WriteCMD(PON);   // 0x04 Power ON
    epd_wait_busy(BUSY_TIMEOUT_POWER_MS);
    vTaskDelay(10 / portTICK_PERIOD_MS);
    m_panel_powered = true;

    EPD_W21_WriteCMD(REF);   // 0x12 Display Refresh
    EPD_W21_WriteDATA(0x00);
    vTaskDelay(10 / portTICK_PERIOD_MS);
    epd_wait_busy(BUSY_TIMEOUT_REFRESH_MS);

    EPD_W21_WriteCMD(POF);   // 0x02 Power OFF
    EPD_W21_WriteDATA(0x00);
    epd_wait_busy(BUSY_TIMEOUT_POWER_MS);
    vTaskDelay(20 / portTICK_PERIOD_MS);
    m_panel_powered = false;
}

static void epd_display_solid(unsigned char color_byte)
{
    unsigned char line[EPD_INPUT_LINE];
    memset(line, color_byte, EPD_INPUT_LINE);

    EPD_W21_WriteCMD(DTM1);
    epd_wait_busy(BUSY_TIMEOUT_INIT_MS);
    for (int row = 0; row < EPD_HEIGHT; row++)
    {
        EPD_W21_WriteDATA_Bulk(line, EPD_INPUT_LINE);
    }

    epd_display_refresh_seq();
}

/*********************************************************************
 * 48 色 SPECTRA 驱动（JD7601/GDEH037E01）
 *
 * 原理：每像素为 8bpp 索引（0-63），拆成两个 3bit 平面
 *   high = index >> 3, low = index & 7
 * 每个平面以 4bpp（2 像素/字节）写入控制器，配合不同波形表多次刷新，
 * 用时间抖动在 6 种物理颜色粒子间混出中间色。硬件本身仍是 6 色屏。
 *********************************************************************/

static void epd_spectra_wave(const uint8_t *lut)
{
    EPD_PROFILE_STAGE_BEGIN(LUT);
    // 波形载入前导 + 799 字节波形表（末尾对齐字节不进入 SPI）
    EPD_W21_WriteCMD(JD7601_CMD_WAVE_PRE);
    EPD_W21_WriteDATA(0x0F);
    EPD_W21_WriteDATA(0xA9);
    EPD_W21_WriteCMD(JD7601_CMD_WRITE_LUT);
    EPD_W21_WriteDATA_Bulk(lut, 799);
    EPD_PROFILE_STAGE_END(LUT);
}

static void epd_spectra_init(void)
{
    EPD_PROFILE_STAGE_BEGIN(INIT);
    EPD_PROFILE_PREPARE();
    // 复位序列（双脉冲），BUSY 极性沿用默认（低电平忙）
    EPD_W21_RST_0; vTaskDelay(20 / portTICK_PERIOD_MS);
    EPD_W21_RST_1; vTaskDelay(10 / portTICK_PERIOD_MS);
    EPD_W21_RST_0; vTaskDelay(20 / portTICK_PERIOD_MS);
    EPD_W21_RST_1; vTaskDelay(10 / portTICK_PERIOD_MS);
    epd_wait_busy(BUSY_TIMEOUT_INIT_MS);
    vTaskDelay(10 / portTICK_PERIOD_MS);

    EPD_W21_WriteCMD(SOFT_START);   // 0xE9
    EPD_W21_WriteDATA(0x01);
    epd_wait_busy(BUSY_TIMEOUT_INIT_MS);

    EPD_W21_WriteCMD(JD7601_CMD_PLL);     // 0x30
    EPD_W21_WriteDATA(0x04);
    EPD_W21_WriteCMD(JD7601_CMD_UNK_41);  // 0x41
    EPD_W21_WriteDATA(0x00);
    EPD_W21_WriteCMD(JD7601_CMD_TEMP);    // 0xE0
    EPD_W21_WriteDATA(0x02);
    EPD_W21_WriteCMD(JD7601_CMD_UNK_E6);  // 0xE6
    EPD_W21_WriteDATA(0x19);

    m_spectra_state = 0;
    m_panel_powered = false;   // 复位序列后面板回到未上电态
    EPD_PROFILE_STAGE_END(INIT);
}

// wait_cycle：先等 BUSY 拉低（进入忙），再等拉高（释放）
static void epd_spectra_wait_cycle(uint32_t assert_timeout_ms, uint32_t release_timeout_ms)
{
    TickType_t start;
    int busy_level = m_busy_active_low ? 0 : 1;

    // 等 BUSY 进入忙
    start = xTaskGetTickCount();
    while (gpio_get_level(EPD_BUSY_PIN) != busy_level)
    {
        vTaskDelay(pdMS_TO_TICKS(1));
        if (((xTaskGetTickCount() - start) * portTICK_PERIOD_MS) > assert_timeout_ms)
        {
            sys_logw(EPD_TAG, "spectra busy assert timeout");
            EPD_PROFILE_TIMEOUT();
            return;
        }
    }

    // 等 BUSY 释放
    start = xTaskGetTickCount();
    while (gpio_get_level(EPD_BUSY_PIN) == busy_level)
    {
        vTaskDelay(pdMS_TO_TICKS(1));
        if (((xTaskGetTickCount() - start) * portTICK_PERIOD_MS) > release_timeout_ms)
        {
            sys_logw(EPD_TAG, "spectra busy release timeout");
            EPD_PROFILE_TIMEOUT();
            return;
        }
    }
}

/**
 * @brief 面板断电（POF），幂等：本来就断电时什么都不做
 *
 * 从 epd_spectra_refresh 里拆出来，是因为黑白快刷会话会在播放期间保持上电、
 * 只在停止播放时补一次断电（见 hal_epd_mono_session_end）。
 */
static void epd_spectra_power_off(void)
{
    if (!m_panel_powered)
    {
        return;
    }

    EPD_PROFILE_STAGE_BEGIN(POF);
    EPD_W21_WriteCMD(POF);   // 0x02
    EPD_W21_WriteDATA(0x00);
    epd_spectra_wait_cycle(1000, BUSY_TIMEOUT_POWER_MS);
    vTaskDelay(20 / portTICK_PERIOD_MS);

    m_panel_powered = false;
    EPD_PROFILE_STAGE_END(POF);
}

static void epd_spectra_refresh(bool power_on, bool power_off)
{
    /* PON 幂等：会话内已上电就不再付一次 PON 的 BUSY 等待（实测约 100ms/次） */
    if (power_on && !m_panel_powered)
    {
        EPD_PROFILE_STAGE_BEGIN(PON);
        EPD_W21_WriteCMD(PON);   // 0x04
        epd_spectra_wait_cycle(1000, BUSY_TIMEOUT_POWER_MS);
        vTaskDelay(10 / portTICK_PERIOD_MS);
        m_panel_powered = true;
        EPD_PROFILE_STAGE_END(PON);
    }

    EPD_PROFILE_STAGE_BEGIN(REF);
    EPD_PROFILE_REF_COUNT();
    EPD_BUSY_TRACE(5);
    EPD_W21_WriteCMD(REF);   // 0x12
    EPD_W21_WriteDATA(0x00);
    EPD_BUSY_TRACE(6);
    epd_spectra_wait_cycle(1000, BUSY_TIMEOUT_REFRESH_MS);
    EPD_BUSY_TRACE(7);
    vTaskDelay(10 / portTICK_PERIOD_MS);
    EPD_BUSY_TRACE(8);

    EPD_PROFILE_STAGE_END(REF);

    if (power_off)
    {
        epd_spectra_power_off();
    }
}

// 写入一整帧（172800 字节 = 480 行 x 360 字节）的填充值
static void epd_spectra_fill(uint8_t fill_byte)
{
    EPD_PROFILE_STAGE_BEGIN(RAM);
    uint8_t line[EPD_INPUT_LINE];
    memset(line, fill_byte, EPD_INPUT_LINE);

    EPD_W21_WriteCMD(DTM1);   // 0x10
    epd_wait_busy(BUSY_TIMEOUT_INIT_MS);
    for (int row = 0; row < EPD_HEIGHT; row++)
    {
        EPD_W21_WriteDATA_Bulk(line, EPD_INPUT_LINE);
    }

    EPD_PROFILE_STAGE_END(RAM);
    epd_spectra_refresh(true, true);
}

static void epd_spectra_full_clear(void)
{
    EPD_PROFILE_PREPARE();
    epd_spectra_wave(full_clear);
    epd_spectra_fill(0x00);
    memset(m_mono_prev, MONO_CODE_INIT_BYTE, EPD_MONO_BYTES);   // 清屏后面板为黑，上一帧按黑复位
    m_spectra_state = 1;
}

// 把一行 8bpp 索引编码为一个 4bpp 平面的 360 字节
static void epd_spectra_encode_row(const uint8_t *row, uint8_t plane, uint8_t *out)
{
    for (int x = 0; x < EPD_WIDTH; x += 2)
    {
        uint8_t a = row[x];
        uint8_t b = row[x + 1];
        if (plane == 0) { a >>= 3; b >>= 3; }
        else            { a &= 7;  b &= 7;  }
        *out++ = (uint8_t)((a << 4) | b);
    }
}

// 写一个平面的整帧数据（输入为 8bpp 索引缓冲）
static void epd_spectra_write_plane(const uint8_t *index8, uint8_t plane)
{
    EPD_PROFILE_STAGE_BEGIN(RAM);
    uint8_t line[EPD_INPUT_LINE];

    EPD_W21_WriteCMD(DTM1);   // 0x10
    epd_wait_busy(BUSY_TIMEOUT_INIT_MS);
    for (int row = 0; row < EPD_HEIGHT; row++)
    {
        epd_spectra_encode_row(index8 + row * EPD_WIDTH, plane, line);
        EPD_W21_WriteDATA_Bulk(line, EPD_INPUT_LINE);
    }
    EPD_PROFILE_STAGE_END(RAM);
}

#ifdef CONFIG_ARK_EPD_ABC_DIAG
/* RAM-only writer: epd_spectra_fill() also refreshes and must NOT be used here. */
static void epd_spectra_write_constant(uint8_t code)
{
    EPD_PROFILE_STAGE_BEGIN(RAM);
    uint8_t line[EPD_INPUT_LINE];
    memset(line, (uint8_t)((code << 4) | code), sizeof(line));
    EPD_W21_WriteCMD(DTM1);
    epd_wait_busy(BUSY_TIMEOUT_INIT_MS);
    for (int row = 0; row < EPD_HEIGHT; row++)
    {
        EPD_W21_WriteDATA_Bulk(line, EPD_INPUT_LINE);
    }
    EPD_PROFILE_STAGE_END(RAM);
}
#endif

// 彩色多相位刷新：mode 0 = ColorFast(2 相), 1 = ColorQual(3 相)
static void epd_spectra_display_color(const uint8_t *index8, uint8_t mode)
{
    // 清理条件：ColorFast 在 state != 1 时清理；
    // ColorQual 仅在 mono(2)/fast-color(3) 之后（state >= 2）才清理
    bool need_clear = (mode == 0) ? (m_spectra_state != 1)
                                  : (m_spectra_state >= 2);
#ifdef CONFIG_ARK_EPD_ABC_DIAG
    /* Same starting operation for all diagnostic modes, including mode 0.
     * This adds one clear REF to the original three Qual REFs, for four total. */
    if (mode == 1) need_clear = true;
#endif
    if (need_clear)
    {
        epd_spectra_full_clear();
    }

    if (mode == 0)
    {
        // ColorFast：高平面 -> 刷新 -> 低平面 -> 刷新 -> 重写高平面（不刷新）
        epd_spectra_wave(fast_color_phase1);
        epd_spectra_write_plane(index8, 0);
        epd_spectra_refresh(true, false);

        epd_spectra_wave(fast_color_phase2);
        epd_spectra_write_plane(index8, 1);
        epd_spectra_refresh(false, true);

        epd_spectra_write_plane(index8, 0);
        m_spectra_state = 3;
    }
    else
    {
        // ColorQual：高平面 -> 刷新 -> 换波形复用 RAM -> 刷新 -> 低平面 -> 刷新
        epd_spectra_wave(qual_phase1);
        epd_spectra_write_plane(index8, 0);
        epd_spectra_refresh(true, false);

        epd_spectra_wave(qual_phase2);
#ifdef CONFIG_ARK_EPD_ABC_DIAG
        const uint8_t diag_mode = index8[0] >> 3;
        if (diag_mode == 1)
        {
            epd_spectra_write_plane(index8, 0);
        }
        else if (diag_mode == 2)
        {
            epd_spectra_write_constant(index8[0] & 7);
        }
        /* Mode 1 controls the extra 172800-byte transfer slot of mode 2.
         * Mode 0 retains RAM reuse; complete refresh timing is not identical. */
#endif
        epd_spectra_refresh(false, false);   // 复用同一控制器 RAM，不重传图

        epd_spectra_wave(qual_phase3);
        epd_spectra_write_plane(index8, 1);
        epd_spectra_refresh(false, true);
        m_spectra_state = 0;
    }
}

/*********************************************************************
 * GLOBAL FUNCTIONS
 *********************************************************************/

void hal_epd_init(void)
{
    gpio_config_t io_conf;

    // BUSY: input
    io_conf.intr_type = GPIO_INTR_DISABLE;
    io_conf.mode = GPIO_MODE_INPUT;
    io_conf.pin_bit_mask = (1ULL << EPD_BUSY_PIN);
    io_conf.pull_down_en = GPIO_PULLDOWN_DISABLE;
    io_conf.pull_up_en = GPIO_PULLUP_DISABLE;
    gpio_config(&io_conf);

    // RST, DC, CS: output
    io_conf.intr_type = GPIO_INTR_DISABLE;
    io_conf.mode = GPIO_MODE_OUTPUT;
    io_conf.pin_bit_mask = (1ULL << EPD_RST_PIN) | (1ULL << EPD_DC_PIN) |
                           (1ULL << EPD_CS_PIN);
    io_conf.pull_down_en = GPIO_PULLDOWN_DISABLE;
    io_conf.pull_up_en = GPIO_PULLUP_DISABLE;
    gpio_config(&io_conf);

    // Initial control pin states
    EPD_W21_CS_1;
    EPD_W21_DC_1;

    // Init hardware SPI (half-duplex, SCK + SDIN controlled by peripheral)
    spi_init();

    sys_logi(EPD_TAG, "EPD initialized (JD7601, hardware SPI half-duplex)");
}

void hal_epd_display_init(void)
{
    reset();
    epd_try_fix_busy_polarity();

    // JD7601 初始化序列（参考官方驱动）
    EPD_W21_WriteCMD(SOFT_START);  // 0xE9
    EPD_W21_WriteDATA(0x01);
    epd_wait_busy(BUSY_TIMEOUT_INIT_MS);

    sys_logi(EPD_TAG, "EPD display initialized (JD7601)");
}

void hal_epd_display_white(void)
{
    epd_display_solid(EPD_COLOR_WHITE);
}

void hal_epd_display_black(void)
{
    epd_display_solid(EPD_COLOR_BLACK);
}

void hal_epd_display_yellow(void)
{
    epd_display_solid(EPD_COLOR_YELLOW);
}

void hal_epd_display_red(void)
{
    epd_display_solid(EPD_COLOR_RED);
}

void hal_epd_display_blue(void)
{
    epd_display_solid(EPD_COLOR_BLUE);
}

void hal_epd_display_green(void)
{
    epd_display_solid(EPD_COLOR_GREEN);
}

void hal_epd_display_pic(const unsigned char *picData)
{
    unsigned int i, j;
    unsigned char line[EPD_INPUT_LINE];

    if (picData == NULL)
    {
        sys_loge(EPD_TAG, "picData is NULL");
        return;
    }

    // 输入为每像素 1 字节的颜色表值（0x00/0xFF/0xFC/0xE0/0x03/0x1C），转换为 JD7601 面板字节
    EPD_W21_WriteCMD(DTM1);
    epd_wait_busy(BUSY_TIMEOUT_INIT_MS);
    for (i = 0; i < EPD_HEIGHT; i++)
    {
        for (j = 0; j < EPD_INPUT_LINE; j++)
        {
            line[j] = (color_lut[picData[i * EPD_WIDTH + 2 * j]] << 4)
                      | color_lut[picData[i * EPD_WIDTH + 2 * j + 1]];
        }
        EPD_W21_WriteDATA_Bulk(line, EPD_INPUT_LINE);
    }

    epd_display_refresh_seq();
    sys_logi(EPD_TAG, "Display pic completed");
}

void hal_epd_display_native_4bpp(const unsigned char *pixels)
{
    if (pixels == NULL) return;
    EPD_W21_WriteCMD(DTM1);
    epd_wait_busy(BUSY_TIMEOUT_INIT_MS);
    for (unsigned i = 0; i < EPD_HEIGHT; ++i)
        EPD_W21_WriteDATA_Bulk(pixels + i * EPD_INPUT_LINE, EPD_INPUT_LINE);
    epd_display_refresh_seq();
}

void hal_epd_display_film(const unsigned char *filmData)
{
    FilmHeader header;
    const unsigned char *pixelData;
    unsigned int i, j;
    unsigned char byte;
    unsigned char cc1, cc2;
    unsigned char line[EPD_INPUT_LINE];

    if (filmData == NULL)
    {
        sys_loge(EPD_TAG, "filmData is NULL");
        return;
    }

    if (film_parse_header(filmData, &header) != ESP_OK)
    {
        sys_loge(EPD_TAG, "Failed to parse film header");
        return;
    }

    sys_logi(EPD_TAG, "Film: %ux%u, format=0x%02X, %u frame(s), %lu bytes",
             header.screenWidth, header.screenHeight,
             header.format,
             (header.frameCount == 0) ? 1u : (unsigned)header.frameCount,
             (unsigned long)header.fileSize);

    pixelData = filmData + FILM_HEADER_SIZE;

    // 只做单帧显示：多帧文件取首帧。后续如需动画，再按 frameCount 循环展示。

    // 按 Format 判别 v1/v2 编码方式并分派到对应驱动路径
    switch (header.format)
    {
    case 0x01:  // v2 MonoFast：1bpp 位图，走黑白快刷
        sys_logi(EPD_TAG, "Film v2 MonoFast");
        hal_epd_display_mono(pixelData);
        return;

    case 0x02:  // v2 ColorQual：8bpp 索引，3 相刷新
        sys_logi(EPD_TAG, "Film v2 ColorQual");
        hal_epd_display_8bpp_mode(pixelData, 1);
        return;

    case 0x03:  // v2 ColorFast：8bpp 索引，2 相刷新
        sys_logi(EPD_TAG, "Film v2 ColorFast");
        hal_epd_display_8bpp_mode(pixelData, 0);
        return;

    default:    // 0x00 v1 4bpp：落入下方原有颜色转换路径
        break;
    }

    // 颜色转换：colorTable 索引 -> colorTable 实际值 -> JD7601 面板字节（4bpp 直写）
    EPD_W21_WriteCMD(DTM1);
    epd_wait_busy(BUSY_TIMEOUT_INIT_MS);
    for (i = 0; i < EPD_HEIGHT; i++)
    {
        for (j = 0; j < EPD_INPUT_LINE; j++)
        {
            byte = pixelData[i * EPD_INPUT_LINE + j];
            cc1 = (byte >> 4) & 0x0F;
            cc2 = byte & 0x0F;
            line[j] = (color_lut[header.colorTable[cc1]] << 4)
                      | color_lut[header.colorTable[cc2]];
        }
        EPD_W21_WriteDATA_Bulk(line, EPD_INPUT_LINE);
    }

    epd_display_refresh_seq();
    sys_logi(EPD_TAG, "Film display completed");
}

void hal_epd_sleep(void)
{
    EPD_PROFILE_SESSION_STOP();
    /* 深睡之前先把面板 DC/DC 断掉：黑白快刷会话期间面板是保持上电的 */
    epd_spectra_power_off();
    EPD_PROFILE_SESSION_END();

    epd_wait_busy(BUSY_TIMEOUT_INIT_MS);
    EPD_W21_WriteCMD(DSLP);  // 0x07
    EPD_W21_WriteDATA(0xA5);

    m_mono_inited = false;   // 睡眠后需重新初始化 spectra
    m_panel_powered = false;

    sys_logi(EPD_TAG, "EPD sleep");
}

void hal_epd_mono_session_begin(void)
{
    if (!m_mono_session) EPD_PROFILE_SESSION_BEGIN();
    m_mono_session = true;
}

void hal_epd_mono_session_end(void)
{
    m_mono_session = false;
    EPD_PROFILE_SESSION_STOP();

    /* 结束"保持上电"的黑白快刷会话：把播放期间省下的那一趟 PON/POF 补上。
       已经在断电态时是空操作，可重复调用。 */
    epd_spectra_power_off();
    EPD_PROFILE_SESSION_END();
}

void hal_epd_pwroff(void)
{
    hal_epd_sleep();
    vTaskDelay(100 / portTICK_PERIOD_MS);

    sys_logi(EPD_TAG, "EPD power off");
}

void hal_epd_deinit(void)
{
    EPD_PROFILE_SESSION_END();
    if (m_spi_device != NULL)
    {
        spi_bus_remove_device(m_spi_device);
        m_spi_device = NULL;
    }
    spi_bus_free(EPD_SPI_HOST);

    gpio_config_t io_conf =
    {
        .pin_bit_mask = (1ULL << EPD_BUSY_PIN) | (1ULL << EPD_RST_PIN) |
        (1ULL << EPD_DC_PIN)   | (1ULL << EPD_CS_PIN) |
        (1ULL << EPD_SCK_PIN)  | (1ULL << EPD_SDIN_PIN),
        .mode = GPIO_MODE_INPUT,
        .pull_up_en = GPIO_PULLUP_DISABLE,
        .pull_down_en = GPIO_PULLDOWN_DISABLE,
        .intr_type = GPIO_INTR_DISABLE,
    };
    gpio_config(&io_conf);

    m_mono_inited = false;   // 释放后需重新初始化 spectra
    m_panel_powered = false; // SPI 已释放，上电状态不再成立

    sys_logi(EPD_TAG, "EPD deinit, SPI and GPIOs released");
}

/*********************************************************************
 * 黑白快刷（MonoFast/MonoClear）
 *
 * 原理：输入 1bpp 位图（720x480/8 = 43200 字节），对每个像素编码
 * (上一帧, 当前帧) 的 2bit 跳变，配合 mono_fast/mono_clear 波形只驱动
 * 发生变化的像素，实现快速、无闪烁的"局刷"效果（JD7601 无窗口命令，
 * 这里仍是全屏写，但差分后仅变化像素被真正驱动）。
 *
 * 位图约定 1=黑、0=白（见 hal_epd.h / film.md 10.3）；面板码位极性见 MONO_CODE_BIT_WHITE。
 *********************************************************************/

static uint8_t epd_spectra_reverse_bits(uint8_t x)
{
    x = (uint8_t)((x >> 4) | (x << 4));
    x = (uint8_t)(((x >> 2) & 0x33) | ((x << 2) & 0xCC));
    return (uint8_t)(((x >> 1) & 0x55) | ((x << 1) & 0xAA));
}

/**
 * 位图字节 → mono 码位字节：先做字节内位序对齐（位图 MSB 在前 → 面板位序），
 * 再按码位极性取反（MONO_CODE_BIT_WHITE）。
 */
static uint8_t epd_spectra_mono_code_byte(uint8_t bitmap_byte)
{
    uint8_t v = epd_spectra_reverse_bits(bitmap_byte);

    if (MONO_CODE_BIT_WHITE)
    {
        v = (uint8_t)~v;
    }

    return v;
}

// 状态转换（prepare）：跨模式时选择对应过渡波形
// 上一帧初值按各分支实际得到的画面复位：清屏为黑 → INIT_BYTE；写白帧 → mono_write 自身已更新
static void epd_spectra_prepare(void)
{
    EPD_PROFILE_PREPARE();
    if (m_spectra_state == 0)
    {
        // native/quality → 全清理（内部已把上一帧复位为黑）
        epd_spectra_full_clear();
    }
    else if (m_spectra_state == 2)
    {
        // mono → 黑白清理：写完面板为白，上一帧由 mono_write 更新为白
        epd_spectra_wave(mono_clear);
        epd_spectra_mono_write(NULL);
        epd_spectra_refresh(true, false);
    }
    else if (m_spectra_state == 3)
    {
        // fast-color → 恢复：未写 mono 帧，按“清屏为黑”复位上一帧
        epd_spectra_wave(restore_after_fast_color);
        epd_spectra_refresh(true, false);
        memset(m_mono_prev, MONO_CODE_INIT_BYTE, EPD_MONO_BYTES);
    }
    m_spectra_state = 1;
}

// 写一帧黑白差分数据。mono_bitmap 为 NULL 时表示全白（清屏）
static void epd_spectra_mono_write(const uint8_t *mono_bitmap)
{
    EPD_PROFILE_STAGE_BEGIN(RAM);
    /* Calls are serialized by the UI/direct-display handoff. Keep this 4-row
     * buffer in internal DMA RAM instead of growing the UI/film task stacks. */
    static DMA_ATTR uint8_t batch[EPD_INPUT_LINE * EPD_MONO_BATCH_LINES];

    EPD_BUSY_TRACE(2);
    EPD_W21_WriteCMD(DTM1);   // 0x10
    EPD_BUSY_TRACE(3);
    epd_wait_busy(BUSY_TIMEOUT_INIT_MS);
    EPD_BUSY_TRACE(9);
    for (int row = 0; row < EPD_HEIGHT; row += EPD_MONO_BATCH_LINES)
    {
        for (int batch_row = 0; batch_row < EPD_MONO_BATCH_LINES; batch_row++)
        {
            uint8_t *line = batch + batch_row * EPD_INPUT_LINE;
            const int y = row + batch_row;
            const uint8_t *src = mono_bitmap ? (mono_bitmap + y * EPD_MONO_LINE) : NULL;
            uint8_t *prev = m_mono_prev + y * EPD_MONO_LINE;
            for (int x = 0; x < EPD_MONO_LINE; x++)
            {
                uint8_t old = prev[x];
                uint8_t next = epd_spectra_mono_code_byte(src ? src[x] : 0x00);
                prev[x] = next;   // 更新上一帧（码位域）
                for (int j = 0; j < 4; j++)
                {
                    line[x * 4 + j] = (uint8_t)(((old << 5) & 0x20) | ((next << 4) & 0x10)
                                                | (old & 2) | ((next >> 1) & 1));
                    old >>= 2;
                    next >>= 2;
                }
            }
        }
        EPD_W21_WriteDATA_Bulk(batch, sizeof(batch));
    }
    EPD_BUSY_TRACE(4);
    EPD_PROFILE_STAGE_END(RAM);
}

static void epd_spectra_mono_display(const uint8_t *mono_bitmap, bool is_clear)
{
    // mono 路径仅在 state != 1 && state != 2 时做状态转换
    if (m_spectra_state != 1 && m_spectra_state != 2)
    {
        epd_spectra_prepare();
    }

    epd_spectra_wave(is_clear ? mono_clear : mono_fast);
    epd_spectra_mono_write(mono_bitmap);

    /* 会话打开时帧间**保持上电**（省掉每帧约 100ms 的 PON/POF），只在会话结束时 POF 一次；
       一次性绘制（UI 页/图片）不打开会话，画完即断电，面板不会一直带电。
       见 hal_epd_mono_session_begin/end。 */
    epd_spectra_refresh(true, !m_mono_session);

    m_spectra_state = 2;
}

/*********************************************************************
 * 48 色 SPECTRA 接口（新增，不影响原 6 色接口）
 *********************************************************************/

// 带 mode 的 8bpp 显示：mode 0 = ColorFast(2 相), 1 = ColorQual(3 相)
void hal_epd_display_8bpp_mode(const unsigned char *index8Data, uint8_t mode)
{
    EPD_PROFILE_BEGIN(mode == 0 ? "color_fast" : "color_qual");
    if (index8Data == NULL)
    {
        sys_loge(EPD_TAG, "index8Data is NULL");
        EPD_PROFILE_ERROR(ESP_ERR_INVALID_ARG);
        EPD_PROFILE_END();
        return;
    }
    if (mode > 1)
    {
        sys_loge(EPD_TAG, "Invalid 8bpp mode: %u (expected 0=ColorFast, 1=ColorQual)", mode);
        EPD_PROFILE_ERROR(ESP_ERR_INVALID_ARG);
        EPD_PROFILE_END();
        return;
    }

#ifdef CONFIG_ARK_EPD_ABC_DIAG
    if (mode == 1)
    {
        const uint8_t diag_mode = index8Data[0] >> 3;
        if (diag_mode > 2)
        {
            sys_loge(EPD_TAG, "ABC diagnostic rejected native marker 0x%02X", index8Data[0]);
            EPD_PROFILE_ERROR(ESP_ERR_INVALID_ARG);
            EPD_PROFILE_END();
            return;
        }
        sys_logi(EPD_TAG, "ABC_DIAG mode=%u B=%u clear=1 qual_ref=3 extra_ram=%u",
                 diag_mode, index8Data[0] & 7, diag_mode == 0 ? 0u : 172800u);
    }
#endif
    epd_spectra_init();
    epd_spectra_display_color(index8Data, mode);
    EPD_PROFILE_END();
    sys_logi(EPD_TAG, "Display 8bpp mode=%u completed", mode);
}

void hal_epd_display_mono(const unsigned char *mono_bitmap)
{
    EPD_PROFILE_BEGIN("mono");
    if (mono_bitmap == NULL)
    {
        sys_loge(EPD_TAG, "mono_bitmap is NULL");
        EPD_PROFILE_ERROR(ESP_ERR_INVALID_ARG);
        EPD_PROFILE_END();
        return;
    }

    // 黑白快刷会话首次调用时初始化一次，之后跨调用保持上一帧实现差分局刷
    if (!m_mono_inited)
    {
        epd_spectra_init();
        m_mono_inited = true;
    }

    epd_spectra_mono_display(mono_bitmap, false);
    EPD_PROFILE_END();
    sys_logd(EPD_TAG, "Display mono (B/W fast refresh) completed");
}

uint32_t hal_epd_get_capabilities(void)
{
    return (uint32_t)(EPD_CAP_4BPP | EPD_CAP_8BPP | EPD_CAP_MONOFAST);
}
