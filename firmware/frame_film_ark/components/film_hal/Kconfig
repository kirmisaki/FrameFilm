## firmware/frame_film_ark/components/film_hal/Kconfig
```kconfig
menu "Ark hardware"

    config ARK_HAS_NFC
        bool "NFC hardware (n16r8 only)"
        default n
        help
            Enable ST25R3916 NFC on the n16r8 board. n4r2 has no NFC
            hardware; keep this off there so the wallet app and driver
            are not built.

    config ARK_UI_CJK_TITLE_FONT
        bool "Include 24/36px CJK title fonts"
        default y
        help
            Build the generated 24px/36px Chinese title glyph subsets.
            n4r2 (4MB flash) turns this off to save about 11KB; its titles
            fall back to the built-in Montserrat/ASCII fonts. The 14px/18px
            Chinese UI body fonts are always included.

    config ARK_INPUT_BACK_KEY
        bool "Fourth key: BACK on GPIO18 (n16r8)"
        default n
        help
            The n16r8 board has a fourth, active-low key on GPIO18.
            It is exposed as INPUT_PRESS_BACK and used to leave apps.

endmenu

menu "Ark EPD experimental preview and diagnostics"

    config ARK_EPD_ABC_PREVIEW
        bool "Enable experimental ABC9 512-color preview playback"
        default y
        help
            Accept the existing experimental Format 0x7F ABC9 container:
            exactly one 720x480 frame of little-endian uint16 pixels 0..511.
            Bits 8..6=A, 5..3=B, 2..0=C drive the original three Qual phases
            after the same full clear. LUTs, voltages and refreshes are unchanged.
            Advertise this playback capability in Ark BLE 0x59 bit5.
            This does not enable diagnostic markers, pattern generation or
            other lab modes, and does not define a public film format.

    config ARK_EPD_ABC_DIAG
        bool "Enable experimental ColorQual A/B/C RAM diagnostic"
        default n
        help
            Laboratory firmware only. Interpret the first native Format2 body
            byte as (diagnostic_mode << 3) | B. Modes: 0=reuse A, 1=rewrite A,
            2=write constant B before the second Qual refresh. Reject modes >2.
            Always full-clear before the original three Qual refreshes. LUTs,
            registers and REF count are identical between diagnostic modes;
            modes 1/2 add one RAM transfer slot, so total timing is NOT fixed.
            Ordinary Format2 pictures are not suitable diagnostic inputs.
            Also accept private lab Format 0x7F, reserved bytes 12..15 ABC9,
            exactly one 720x480 frame of little-endian uint16 pixels 0..511.
            Bits 8..6=A, 5..3=B, 2..0=C drive the original three Qual phases
            with a RAM-only write per phase, after the same full clear.
            Invalid high bits are rejected before any clear or refresh.
            No new public film format or BLE command is introduced.

    config ARK_EPD_PROFILE
        bool "Enable per-frame driver timing"
        default n
        help
            Emit one ESP_LOGI EPD_PROFILE JSON record per mono or 8bpp display
            driver call. Keep the ESP-IDF log level at Info or higher to see it.
            All timings use microseconds; this is not end-to-end FPS.
            Stages include preparation passes and original command/wait/delay
            time. RAM timing includes encoding and SPI transfer. This option
            does not modify LUTs, SPI frequency, panel timings or recovery.

endmenu
```

## firmware/frame_film_c3/main/Kconfig.projbuild
```kconfig
menu "FrameFilm C3 board (independent model)"
config FRAMEFILM_C3_EPD_MOSI
    int "EPD MOSI GPIO"
    range 0 21
    default 3
config FRAMEFILM_C3_EPD_SCK
    int "EPD SCK GPIO"
    range 0 21
    default 4
config FRAMEFILM_C3_EPD_CS
    int "EPD CS GPIO"
    range 0 21
    default 5
config FRAMEFILM_C3_EPD_DC
    int "EPD DC GPIO"
    range 0 21
    default 6
config FRAMEFILM_C3_EPD_RST
    int "EPD reset GPIO"
    range 0 21
    default 7
config FRAMEFILM_C3_EPD_BUSY
    int "EPD BUSY GPIO (active low)"
    range 0 21
    default 10
endmenu
```

## firmware/frame_film_c3/sdkconfig.defaults
```kconfig
CONFIG_IDF_TARGET="esp32c3"
CONFIG_ESPTOOLPY_FLASHSIZE_4MB=y
CONFIG_PARTITION_TABLE_CUSTOM=y
CONFIG_PARTITION_TABLE_CUSTOM_FILENAME="partitions.csv"
CONFIG_BT_ENABLED=y
CONFIG_BT_BLUEDROID_ENABLED=y
CONFIG_BT_BLE_ENABLED=y
CONFIG_BT_CLASSIC_ENABLED=n
CONFIG_BT_BLE_42_FEATURES_SUPPORTED=y
CONFIG_BT_BLE_50_FEATURES_SUPPORTED=n
CONFIG_BT_BLE_DYNAMIC_ENV_MEMORY=y
CONFIG_BT_ALLOCATION_FROM_SPIRAM_FIRST=n
CONFIG_ESP_MAIN_TASK_STACK_SIZE=6144
CONFIG_COMPILER_OPTIMIZATION_SIZE=y
```
